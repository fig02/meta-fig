## meta-fig-camera/conf/layer.conf
```bitbake
# We have a conf and classes directory, add to BBPATH
BBPATH .= ":${LAYERDIR}"

# We have recipes-* directories, add to BBFILES
BBFILES += "${LAYERDIR}/recipes-*/*/*.bb \
            ${LAYERDIR}/recipes-*/*/*.bbappend"

BBFILE_COLLECTIONS += "meta-fig-camera"
BBFILE_PATTERN_meta-fig-camera = "^${LAYERDIR}/"
BBFILE_PRIORITY_meta-fig-camera = "6"

LAYERDEPENDS_meta-fig-camera = "core"
LAYERSERIES_COMPAT_meta-fig-camera = "scarthgap"
```

## meta-fig-os/conf/distro/fig-os.conf
```bitbake
# meta-fig-os/conf/distro/fig-os.conf

DISTRO = "fig-os"
DISTRO_NAME = "FigOS"
DISTRO_VERSION = "1.0"

# init system config
DISTRO_FEATURES:remove = "systemd"
VIRTUAL-RUNTIME_init_manager = "sysvinit"
VIRTUAL-RUNTIME_initscripts = "initscripts"

# remove some uneeded default features
DISTRO_FEATURES:remove = "3g bluetooth nfc wifi"
DISTRO_FEATURES:remove = "opengl vulkan wayland x11"
DISTRO_FEATURES:remove = "pci pcmcia usbhost usbgadget nfs"
DISTRO_FEATURES:remove = "ptest alsa pulseaudio"

# disable some hardware components
RPI_EXTRA_CONFIG .= "dtoverlay=disable-bt"
RPI_EXTRA_CONFIG .= "\ndtoverlay=disable-usb"

RPI_USE_U_BOOT = "1"
PREFERRED_VERSION_u-boot = "2024.04%"

# set locale to prevent unecessary locale packages
GLIBC_GENERATE_LOCALES = "en_US.UTF-8"

# raspberry pi license thing
LICENSE_FLAGS_ACCEPTED += "synaptics-killswitch"

require conf/distro/poky.conf
```
